.ifndef INCLUDED_CYFITTERGNU_INC
.set INCLUDED_CYFITTERGNU_INC, 1
.include "cydevicegnu.inc"
.include "cydevicegnu_trm.inc"

/* LCD_Char_1_LCDPort */
.set LCD_Char_1_LCDPort__0__MASK, 0x01
.set LCD_Char_1_LCDPort__0__PC, CYREG_PRT2_PC0
.set LCD_Char_1_LCDPort__0__PORT, 2
.set LCD_Char_1_LCDPort__0__SHIFT, 0
.set LCD_Char_1_LCDPort__1__MASK, 0x02
.set LCD_Char_1_LCDPort__1__PC, CYREG_PRT2_PC1
.set LCD_Char_1_LCDPort__1__PORT, 2
.set LCD_Char_1_LCDPort__1__SHIFT, 1
.set LCD_Char_1_LCDPort__2__MASK, 0x04
.set LCD_Char_1_LCDPort__2__PC, CYREG_PRT2_PC2
.set LCD_Char_1_LCDPort__2__PORT, 2
.set LCD_Char_1_LCDPort__2__SHIFT, 2
.set LCD_Char_1_LCDPort__3__MASK, 0x08
.set LCD_Char_1_LCDPort__3__PC, CYREG_PRT2_PC3
.set LCD_Char_1_LCDPort__3__PORT, 2
.set LCD_Char_1_LCDPort__3__SHIFT, 3
.set LCD_Char_1_LCDPort__4__MASK, 0x10
.set LCD_Char_1_LCDPort__4__PC, CYREG_PRT2_PC4
.set LCD_Char_1_LCDPort__4__PORT, 2
.set LCD_Char_1_LCDPort__4__SHIFT, 4
.set LCD_Char_1_LCDPort__5__MASK, 0x20
.set LCD_Char_1_LCDPort__5__PC, CYREG_PRT2_PC5
.set LCD_Char_1_LCDPort__5__PORT, 2
.set LCD_Char_1_LCDPort__5__SHIFT, 5
.set LCD_Char_1_LCDPort__6__MASK, 0x40
.set LCD_Char_1_LCDPort__6__PC, CYREG_PRT2_PC6
.set LCD_Char_1_LCDPort__6__PORT, 2
.set LCD_Char_1_LCDPort__6__SHIFT, 6
.set LCD_Char_1_LCDPort__AG, CYREG_PRT2_AG
.set LCD_Char_1_LCDPort__AMUX, CYREG_PRT2_AMUX
.set LCD_Char_1_LCDPort__BIE, CYREG_PRT2_BIE
.set LCD_Char_1_LCDPort__BIT_MASK, CYREG_PRT2_BIT_MASK
.set LCD_Char_1_LCDPort__BYP, CYREG_PRT2_BYP
.set LCD_Char_1_LCDPort__CTL, CYREG_PRT2_CTL
.set LCD_Char_1_LCDPort__DM0, CYREG_PRT2_DM0
.set LCD_Char_1_LCDPort__DM1, CYREG_PRT2_DM1
.set LCD_Char_1_LCDPort__DM2, CYREG_PRT2_DM2
.set LCD_Char_1_LCDPort__DR, CYREG_PRT2_DR
.set LCD_Char_1_LCDPort__INP_DIS, CYREG_PRT2_INP_DIS
.set LCD_Char_1_LCDPort__LCD_COM_SEG, CYREG_PRT2_LCD_COM_SEG
.set LCD_Char_1_LCDPort__LCD_EN, CYREG_PRT2_LCD_EN
.set LCD_Char_1_LCDPort__MASK, 0x7F
.set LCD_Char_1_LCDPort__PORT, 2
.set LCD_Char_1_LCDPort__PRT, CYREG_PRT2_PRT
.set LCD_Char_1_LCDPort__PRTDSI__CAPS_SEL, CYREG_PRT2_CAPS_SEL
.set LCD_Char_1_LCDPort__PRTDSI__DBL_SYNC_IN, CYREG_PRT2_DBL_SYNC_IN
.set LCD_Char_1_LCDPort__PRTDSI__OE_SEL0, CYREG_PRT2_OE_SEL0
.set LCD_Char_1_LCDPort__PRTDSI__OE_SEL1, CYREG_PRT2_OE_SEL1
.set LCD_Char_1_LCDPort__PRTDSI__OUT_SEL0, CYREG_PRT2_OUT_SEL0
.set LCD_Char_1_LCDPort__PRTDSI__OUT_SEL1, CYREG_PRT2_OUT_SEL1
.set LCD_Char_1_LCDPort__PRTDSI__SYNC_OUT, CYREG_PRT2_SYNC_OUT
.set LCD_Char_1_LCDPort__PS, CYREG_PRT2_PS
.set LCD_Char_1_LCDPort__SHIFT, 0
.set LCD_Char_1_LCDPort__SLW, CYREG_PRT2_SLW

/* UART_IntClock */
.set UART_IntClock__CFG0, CYREG_CLKDIST_DCFG1_CFG0
.set UART_IntClock__CFG1, CYREG_CLKDIST_DCFG1_CFG1
.set UART_IntClock__CFG2, CYREG_CLKDIST_DCFG1_CFG2
.set UART_IntClock__CFG2_SRC_SEL_MASK, 0x07
.set UART_IntClock__INDEX, 0x01
.set UART_IntClock__PM_ACT_CFG, CYREG_PM_ACT_CFG2
.set UART_IntClock__PM_ACT_MSK, 0x02
.set UART_IntClock__PM_STBY_CFG, CYREG_PM_STBY_CFG2
.set UART_IntClock__PM_STBY_MSK, 0x02

/* isr_HREF_LOW */
.set isr_HREF_LOW__INTC_CLR_EN_REG, CYREG_NVIC_CLRENA0
.set isr_HREF_LOW__INTC_CLR_PD_REG, CYREG_NVIC_CLRPEND0
.set isr_HREF_LOW__INTC_MASK, 0x02
.set isr_HREF_LOW__INTC_NUMBER, 1
.set isr_HREF_LOW__INTC_PRIOR_NUM, 7
.set isr_HREF_LOW__INTC_PRIOR_REG, CYREG_NVIC_PRI_1
.set isr_HREF_LOW__INTC_SET_EN_REG, CYREG_NVIC_SETENA0
.set isr_HREF_LOW__INTC_SET_PD_REG, CYREG_NVIC_SETPEND0

/* UART_BUART */
.set UART_BUART_sRX_RxBitCounter_ST__16BIT_STATUS_AUX_CTL_REG, CYREG_B1_UDB05_06_ACTL
.set UART_BUART_sRX_RxBitCounter_ST__16BIT_STATUS_REG, CYREG_B1_UDB05_06_ST
.set UART_BUART_sRX_RxBitCounter_ST__MASK_REG, CYREG_B1_UDB05_MSK
.set UART_BUART_sRX_RxBitCounter_ST__MASK_ST_AUX_CTL_REG, CYREG_B1_UDB05_MSK_ACTL
.set UART_BUART_sRX_RxBitCounter_ST__PER_ST_AUX_CTL_REG, CYREG_B1_UDB05_MSK_ACTL
.set UART_BUART_sRX_RxBitCounter_ST__STATUS_AUX_CTL_REG, CYREG_B1_UDB05_ACTL
.set UART_BUART_sRX_RxBitCounter_ST__STATUS_CNT_REG, CYREG_B1_UDB05_ST_CTL
.set UART_BUART_sRX_RxBitCounter_ST__STATUS_CONTROL_REG, CYREG_B1_UDB05_ST_CTL
.set UART_BUART_sRX_RxBitCounter_ST__STATUS_REG, CYREG_B1_UDB05_ST
.set UART_BUART_sRX_RxBitCounter__16BIT_CONTROL_AUX_CTL_REG, CYREG_B1_UDB05_06_ACTL
.set UART_BUART_sRX_RxBitCounter__16BIT_CONTROL_CONTROL_REG, CYREG_B1_UDB05_06_CTL
.set UART_BUART_sRX_RxBitCounter__16BIT_CONTROL_COUNT_REG, CYREG_B1_UDB05_06_CTL
.set UART_BUART_sRX_RxBitCounter__16BIT_COUNT_CONTROL_REG, CYREG_B1_UDB05_06_CTL
.set UART_BUART_sRX_RxBitCounter__16BIT_COUNT_COUNT_REG, CYREG_B1_UDB05_06_CTL
.set UART_BUART_sRX_RxBitCounter__16BIT_MASK_MASK_REG, CYREG_B1_UDB05_06_MSK
.set UART_BUART_sRX_RxBitCounter__16BIT_MASK_PERIOD_REG, CYREG_B1_UDB05_06_MSK
.set UART_BUART_sRX_RxBitCounter__16BIT_PERIOD_MASK_REG, CYREG_B1_UDB05_06_MSK
.set UART_BUART_sRX_RxBitCounter__16BIT_PERIOD_PERIOD_REG, CYREG_B1_UDB05_06_MSK
.set UART_BUART_sRX_RxBitCounter__CONTROL_AUX_CTL_REG, CYREG_B1_UDB05_ACTL
.set UART_BUART_sRX_RxBitCounter__CONTROL_REG, CYREG_B1_UDB05_CTL
.set UART_BUART_sRX_RxBitCounter__CONTROL_ST_REG, CYREG_B1_UDB05_ST_CTL
.set UART_BUART_sRX_RxBitCounter__COUNT_REG, CYREG_B1_UDB05_CTL
.set UART_BUART_sRX_RxBitCounter__COUNT_ST_REG, CYREG_B1_UDB05_ST_CTL
.set UART_BUART_sRX_RxBitCounter__MASK_CTL_AUX_CTL_REG, CYREG_B1_UDB05_MSK_ACTL
.set UART_BUART_sRX_RxBitCounter__PERIOD_REG, CYREG_B1_UDB05_MSK
.set UART_BUART_sRX_RxBitCounter__PER_CTL_AUX_CTL_REG, CYREG_B1_UDB05_MSK_ACTL
.set UART_BUART_sRX_RxShifter_u0__16BIT_A0_REG, CYREG_B1_UDB06_07_A0
.set UART_BUART_sRX_RxShifter_u0__16BIT_A1_REG, CYREG_B1_UDB06_07_A1
.set UART_BUART_sRX_RxShifter_u0__16BIT_D0_REG, CYREG_B1_UDB06_07_D0
.set UART_BUART_sRX_RxShifter_u0__16BIT_D1_REG, CYREG_B1_UDB06_07_D1
.set UART_BUART_sRX_RxShifter_u0__16BIT_DP_AUX_CTL_REG, CYREG_B1_UDB06_07_ACTL
.set UART_BUART_sRX_RxShifter_u0__16BIT_F0_REG, CYREG_B1_UDB06_07_F0
.set UART_BUART_sRX_RxShifter_u0__16BIT_F1_REG, CYREG_B1_UDB06_07_F1
.set UART_BUART_sRX_RxShifter_u0__A0_A1_REG, CYREG_B1_UDB06_A0_A1
.set UART_BUART_sRX_RxShifter_u0__A0_REG, CYREG_B1_UDB06_A0
.set UART_BUART_sRX_RxShifter_u0__A1_REG, CYREG_B1_UDB06_A1
.set UART_BUART_sRX_RxShifter_u0__D0_D1_REG, CYREG_B1_UDB06_D0_D1
.set UART_BUART_sRX_RxShifter_u0__D0_REG, CYREG_B1_UDB06_D0
.set UART_BUART_sRX_RxShifter_u0__D1_REG, CYREG_B1_UDB06_D1
.set UART_BUART_sRX_RxShifter_u0__DP_AUX_CTL_REG, CYREG_B1_UDB06_ACTL
.set UART_BUART_sRX_RxShifter_u0__F0_F1_REG, CYREG_B1_UDB06_F0_F1
.set UART_BUART_sRX_RxShifter_u0__F0_REG, CYREG_B1_UDB06_F0
.set UART_BUART_sRX_RxShifter_u0__F1_REG, CYREG_B1_UDB06_F1
.set UART_BUART_sRX_RxSts__16BIT_STATUS_AUX_CTL_REG, CYREG_B1_UDB06_07_ACTL
.set UART_BUART_sRX_RxSts__16BIT_STATUS_REG, CYREG_B1_UDB06_07_ST
.set UART_BUART_sRX_RxSts__3__MASK, 0x08
.set UART_BUART_sRX_RxSts__3__POS, 3
.set UART_BUART_sRX_RxSts__4__MASK, 0x10
.set UART_BUART_sRX_RxSts__4__POS, 4
.set UART_BUART_sRX_RxSts__5__MASK, 0x20
.set UART_BUART_sRX_RxSts__5__POS, 5
.set UART_BUART_sRX_RxSts__MASK, 0x38
.set UART_BUART_sRX_RxSts__MASK_REG, CYREG_B1_UDB06_MSK
.set UART_BUART_sRX_RxSts__STATUS_AUX_CTL_REG, CYREG_B1_UDB06_ACTL
.set UART_BUART_sRX_RxSts__STATUS_REG, CYREG_B1_UDB06_ST
.set UART_BUART_sTX_TxShifter_u0__16BIT_A0_REG, CYREG_B1_UDB07_08_A0
.set UART_BUART_sTX_TxShifter_u0__16BIT_A1_REG, CYREG_B1_UDB07_08_A1
.set UART_BUART_sTX_TxShifter_u0__16BIT_D0_REG, CYREG_B1_UDB07_08_D0
.set UART_BUART_sTX_TxShifter_u0__16BIT_D1_REG, CYREG_B1_UDB07_08_D1
.set UART_BUART_sTX_TxShifter_u0__16BIT_DP_AUX_CTL_REG, CYREG_B1_UDB07_08_ACTL
.set UART_BUART_sTX_TxShifter_u0__16BIT_F0_REG, CYREG_B1_UDB07_08_F0
.set UART_BUART_sTX_TxShifter_u0__16BIT_F1_REG, CYREG_B1_UDB07_08_F1
.set UART_BUART_sTX_TxShifter_u0__A0_A1_REG, CYREG_B1_UDB07_A0_A1
.set UART_BUART_sTX_TxShifter_u0__A0_REG, CYREG_B1_UDB07_A0
.set UART_BUART_sTX_TxShifter_u0__A1_REG, CYREG_B1_UDB07_A1
.set UART_BUART_sTX_TxShifter_u0__D0_D1_REG, CYREG_B1_UDB07_D0_D1
.set UART_BUART_sTX_TxShifter_u0__D0_REG, CYREG_B1_UDB07_D0
.set UART_BUART_sTX_TxShifter_u0__D1_REG, CYREG_B1_UDB07_D1
.set UART_BUART_sTX_TxShifter_u0__DP_AUX_CTL_REG, CYREG_B1_UDB07_ACTL
.set UART_BUART_sTX_TxShifter_u0__F0_F1_REG, CYREG_B1_UDB07_F0_F1
.set UART_BUART_sTX_TxShifter_u0__F0_REG, CYREG_B1_UDB07_F0
.set UART_BUART_sTX_TxShifter_u0__F1_REG, CYREG_B1_UDB07_F1
.set UART_BUART_sTX_TxSts__0__MASK, 0x01
.set UART_BUART_sTX_TxSts__0__POS, 0
.set UART_BUART_sTX_TxSts__16BIT_STATUS_AUX_CTL_REG, CYREG_B0_UDB07_08_ACTL
.set UART_BUART_sTX_TxSts__16BIT_STATUS_REG, CYREG_B0_UDB07_08_ST
.set UART_BUART_sTX_TxSts__1__MASK, 0x02
.set UART_BUART_sTX_TxSts__1__POS, 1
.set UART_BUART_sTX_TxSts__2__MASK, 0x04
.set UART_BUART_sTX_TxSts__2__POS, 2
.set UART_BUART_sTX_TxSts__3__MASK, 0x08
.set UART_BUART_sTX_TxSts__3__POS, 3
.set UART_BUART_sTX_TxSts__MASK, 0x0F
.set UART_BUART_sTX_TxSts__MASK_REG, CYREG_B0_UDB07_MSK
.set UART_BUART_sTX_TxSts__STATUS_AUX_CTL_REG, CYREG_B0_UDB07_ACTL
.set UART_BUART_sTX_TxSts__STATUS_REG, CYREG_B0_UDB07_ST
.set UART_BUART_sTX_sCLOCK_TxBitClkGen__16BIT_A0_REG, CYREG_B0_UDB07_08_A0
.set UART_BUART_sTX_sCLOCK_TxBitClkGen__16BIT_A1_REG, CYREG_B0_UDB07_08_A1
.set UART_BUART_sTX_sCLOCK_TxBitClkGen__16BIT_D0_REG, CYREG_B0_UDB07_08_D0
.set UART_BUART_sTX_sCLOCK_TxBitClkGen__16BIT_D1_REG, CYREG_B0_UDB07_08_D1
.set UART_BUART_sTX_sCLOCK_TxBitClkGen__16BIT_DP_AUX_CTL_REG, CYREG_B0_UDB07_08_ACTL
.set UART_BUART_sTX_sCLOCK_TxBitClkGen__16BIT_F0_REG, CYREG_B0_UDB07_08_F0
.set UART_BUART_sTX_sCLOCK_TxBitClkGen__16BIT_F1_REG, CYREG_B0_UDB07_08_F1
.set UART_BUART_sTX_sCLOCK_TxBitClkGen__A0_A1_REG, CYREG_B0_UDB07_A0_A1
.set UART_BUART_sTX_sCLOCK_TxBitClkGen__A0_REG, CYREG_B0_UDB07_A0
.set UART_BUART_sTX_sCLOCK_TxBitClkGen__A1_REG, CYREG_B0_UDB07_A1
.set UART_BUART_sTX_sCLOCK_TxBitClkGen__D0_D1_REG, CYREG_B0_UDB07_D0_D1
.set UART_BUART_sTX_sCLOCK_TxBitClkGen__D0_REG, CYREG_B0_UDB07_D0
.set UART_BUART_sTX_sCLOCK_TxBitClkGen__D1_REG, CYREG_B0_UDB07_D1
.set UART_BUART_sTX_sCLOCK_TxBitClkGen__DP_AUX_CTL_REG, CYREG_B0_UDB07_ACTL
.set UART_BUART_sTX_sCLOCK_TxBitClkGen__F0_F1_REG, CYREG_B0_UDB07_F0_F1
.set UART_BUART_sTX_sCLOCK_TxBitClkGen__F0_REG, CYREG_B0_UDB07_F0
.set UART_BUART_sTX_sCLOCK_TxBitClkGen__F1_REG, CYREG_B0_UDB07_F1

/* ClockLine */
.set ClockLine__0__MASK, 0x10
.set ClockLine__0__PC, CYREG_PRT12_PC4
.set ClockLine__0__PORT, 12
.set ClockLine__0__SHIFT, 4
.set ClockLine__AG, CYREG_PRT12_AG
.set ClockLine__BIE, CYREG_PRT12_BIE
.set ClockLine__BIT_MASK, CYREG_PRT12_BIT_MASK
.set ClockLine__BYP, CYREG_PRT12_BYP
.set ClockLine__DM0, CYREG_PRT12_DM0
.set ClockLine__DM1, CYREG_PRT12_DM1
.set ClockLine__DM2, CYREG_PRT12_DM2
.set ClockLine__DR, CYREG_PRT12_DR
.set ClockLine__INP_DIS, CYREG_PRT12_INP_DIS
.set ClockLine__MASK, 0x10
.set ClockLine__PORT, 12
.set ClockLine__PRT, CYREG_PRT12_PRT
.set ClockLine__PRTDSI__DBL_SYNC_IN, CYREG_PRT12_DBL_SYNC_IN
.set ClockLine__PRTDSI__OE_SEL0, CYREG_PRT12_OE_SEL0
.set ClockLine__PRTDSI__OE_SEL1, CYREG_PRT12_OE_SEL1
.set ClockLine__PRTDSI__OUT_SEL0, CYREG_PRT12_OUT_SEL0
.set ClockLine__PRTDSI__OUT_SEL1, CYREG_PRT12_OUT_SEL1
.set ClockLine__PRTDSI__SYNC_OUT, CYREG_PRT12_SYNC_OUT
.set ClockLine__PS, CYREG_PRT12_PS
.set ClockLine__SHIFT, 4
.set ClockLine__SIO_CFG, CYREG_PRT12_SIO_CFG
.set ClockLine__SIO_DIFF, CYREG_PRT12_SIO_DIFF
.set ClockLine__SIO_HYST_EN, CYREG_PRT12_SIO_HYST_EN
.set ClockLine__SIO_REG_HIFREQ, CYREG_PRT12_SIO_REG_HIFREQ
.set ClockLine__SLW, CYREG_PRT12_SLW

/* DataLine */
.set DataLine__0__MASK, 0x20
.set DataLine__0__PC, CYREG_PRT12_PC5
.set DataLine__0__PORT, 12
.set DataLine__0__SHIFT, 5
.set DataLine__AG, CYREG_PRT12_AG
.set DataLine__BIE, CYREG_PRT12_BIE
.set DataLine__BIT_MASK, CYREG_PRT12_BIT_MASK
.set DataLine__BYP, CYREG_PRT12_BYP
.set DataLine__DM0, CYREG_PRT12_DM0
.set DataLine__DM1, CYREG_PRT12_DM1
.set DataLine__DM2, CYREG_PRT12_DM2
.set DataLine__DR, CYREG_PRT12_DR
.set DataLine__INP_DIS, CYREG_PRT12_INP_DIS
.set DataLine__MASK, 0x20
.set DataLine__PORT, 12
.set DataLine__PRT, CYREG_PRT12_PRT
.set DataLine__PRTDSI__DBL_SYNC_IN, CYREG_PRT12_DBL_SYNC_IN
.set DataLine__PRTDSI__OE_SEL0, CYREG_PRT12_OE_SEL0
.set DataLine__PRTDSI__OE_SEL1, CYREG_PRT12_OE_SEL1
.set DataLine__PRTDSI__OUT_SEL0, CYREG_PRT12_OUT_SEL0
.set DataLine__PRTDSI__OUT_SEL1, CYREG_PRT12_OUT_SEL1
.set DataLine__PRTDSI__SYNC_OUT, CYREG_PRT12_SYNC_OUT
.set DataLine__PS, CYREG_PRT12_PS
.set DataLine__SHIFT, 5
.set DataLine__SIO_CFG, CYREG_PRT12_SIO_CFG
.set DataLine__SIO_DIFF, CYREG_PRT12_SIO_DIFF
.set DataLine__SIO_HYST_EN, CYREG_PRT12_SIO_HYST_EN
.set DataLine__SIO_REG_HIFREQ, CYREG_PRT12_SIO_REG_HIFREQ
.set DataLine__SLW, CYREG_PRT12_SLW

/* isr_HREF */
.set isr_HREF__INTC_CLR_EN_REG, CYREG_NVIC_CLRENA0
.set isr_HREF__INTC_CLR_PD_REG, CYREG_NVIC_CLRPEND0
.set isr_HREF__INTC_MASK, 0x01
.set isr_HREF__INTC_NUMBER, 0
.set isr_HREF__INTC_PRIOR_NUM, 7
.set isr_HREF__INTC_PRIOR_REG, CYREG_NVIC_PRI_0
.set isr_HREF__INTC_SET_EN_REG, CYREG_NVIC_SETENA0
.set isr_HREF__INTC_SET_PD_REG, CYREG_NVIC_SETPEND0

/* isr_PCLK */
.set isr_PCLK__INTC_CLR_EN_REG, CYREG_NVIC_CLRENA0
.set isr_PCLK__INTC_CLR_PD_REG, CYREG_NVIC_CLRPEND0
.set isr_PCLK__INTC_MASK, 0x04
.set isr_PCLK__INTC_NUMBER, 2
.set isr_PCLK__INTC_PRIOR_NUM, 7
.set isr_PCLK__INTC_PRIOR_REG, CYREG_NVIC_PRI_2
.set isr_PCLK__INTC_SET_EN_REG, CYREG_NVIC_SETENA0
.set isr_PCLK__INTC_SET_PD_REG, CYREG_NVIC_SETPEND0

/* isr_VREF */
.set isr_VREF__INTC_CLR_EN_REG, CYREG_NVIC_CLRENA0
.set isr_VREF__INTC_CLR_PD_REG, CYREG_NVIC_CLRPEND0
.set isr_VREF__INTC_MASK, 0x08
.set isr_VREF__INTC_NUMBER, 3
.set isr_VREF__INTC_PRIOR_NUM, 7
.set isr_VREF__INTC_PRIOR_REG, CYREG_NVIC_PRI_3
.set isr_VREF__INTC_SET_EN_REG, CYREG_NVIC_SETENA0
.set isr_VREF__INTC_SET_PD_REG, CYREG_NVIC_SETPEND0

/* Clock_1 */
.set Clock_1__CFG0, CYREG_CLKDIST_DCFG0_CFG0
.set Clock_1__CFG1, CYREG_CLKDIST_DCFG0_CFG1
.set Clock_1__CFG2, CYREG_CLKDIST_DCFG0_CFG2
.set Clock_1__CFG2_SRC_SEL_MASK, 0x07
.set Clock_1__INDEX, 0x00
.set Clock_1__PM_ACT_CFG, CYREG_PM_ACT_CFG2
.set Clock_1__PM_ACT_MSK, 0x01
.set Clock_1__PM_STBY_CFG, CYREG_PM_STBY_CFG2
.set Clock_1__PM_STBY_MSK, 0x01

/* DataBus */
.set DataBus__0__MASK, 0x01
.set DataBus__0__PC, CYREG_PRT4_PC0
.set DataBus__0__PORT, 4
.set DataBus__0__SHIFT, 0
.set DataBus__1__MASK, 0x02
.set DataBus__1__PC, CYREG_PRT4_PC1
.set DataBus__1__PORT, 4
.set DataBus__1__SHIFT, 1
.set DataBus__2__MASK, 0x04
.set DataBus__2__PC, CYREG_PRT4_PC2
.set DataBus__2__PORT, 4
.set DataBus__2__SHIFT, 2
.set DataBus__3__MASK, 0x08
.set DataBus__3__PC, CYREG_PRT4_PC3
.set DataBus__3__PORT, 4
.set DataBus__3__SHIFT, 3
.set DataBus__4__MASK, 0x10
.set DataBus__4__PC, CYREG_PRT4_PC4
.set DataBus__4__PORT, 4
.set DataBus__4__SHIFT, 4
.set DataBus__5__MASK, 0x20
.set DataBus__5__PC, CYREG_PRT4_PC5
.set DataBus__5__PORT, 4
.set DataBus__5__SHIFT, 5
.set DataBus__6__MASK, 0x40
.set DataBus__6__PC, CYREG_PRT4_PC6
.set DataBus__6__PORT, 4
.set DataBus__6__SHIFT, 6
.set DataBus__7__MASK, 0x80
.set DataBus__7__PC, CYREG_PRT4_PC7
.set DataBus__7__PORT, 4
.set DataBus__7__SHIFT, 7
.set DataBus__AG, CYREG_PRT4_AG
.set DataBus__AMUX, CYREG_PRT4_AMUX
.set DataBus__BIE, CYREG_PRT4_BIE
.set DataBus__BIT_MASK, CYREG_PRT4_BIT_MASK
.set DataBus__BYP, CYREG_PRT4_BYP
.set DataBus__CTL, CYREG_PRT4_CTL
.set DataBus__DM0, CYREG_PRT4_DM0
.set DataBus__DM1, CYREG_PRT4_DM1
.set DataBus__DM2, CYREG_PRT4_DM2
.set DataBus__DR, CYREG_PRT4_DR
.set DataBus__INP_DIS, CYREG_PRT4_INP_DIS
.set DataBus__LCD_COM_SEG, CYREG_PRT4_LCD_COM_SEG
.set DataBus__LCD_EN, CYREG_PRT4_LCD_EN
.set DataBus__MASK, 0xFF
.set DataBus__PORT, 4
.set DataBus__PRT, CYREG_PRT4_PRT
.set DataBus__PRTDSI__CAPS_SEL, CYREG_PRT4_CAPS_SEL
.set DataBus__PRTDSI__DBL_SYNC_IN, CYREG_PRT4_DBL_SYNC_IN
.set DataBus__PRTDSI__OE_SEL0, CYREG_PRT4_OE_SEL0
.set DataBus__PRTDSI__OE_SEL1, CYREG_PRT4_OE_SEL1
.set DataBus__PRTDSI__OUT_SEL0, CYREG_PRT4_OUT_SEL0
.set DataBus__PRTDSI__OUT_SEL1, CYREG_PRT4_OUT_SEL1
.set DataBus__PRTDSI__SYNC_OUT, CYREG_PRT4_SYNC_OUT
.set DataBus__PS, CYREG_PRT4_PS
.set DataBus__SHIFT, 0
.set DataBus__SLW, CYREG_PRT4_SLW

/* isr_rx */
.set isr_rx__INTC_CLR_EN_REG, CYREG_NVIC_CLRENA0
.set isr_rx__INTC_CLR_PD_REG, CYREG_NVIC_CLRPEND0
.set isr_rx__INTC_MASK, 0x10
.set isr_rx__INTC_NUMBER, 4
.set isr_rx__INTC_PRIOR_NUM, 7
.set isr_rx__INTC_PRIOR_REG, CYREG_NVIC_PRI_4
.set isr_rx__INTC_SET_EN_REG, CYREG_NVIC_SETENA0
.set isr_rx__INTC_SET_PD_REG, CYREG_NVIC_SETPEND0

/* isr_tx */
.set isr_tx__INTC_CLR_EN_REG, CYREG_NVIC_CLRENA0
.set isr_tx__INTC_CLR_PD_REG, CYREG_NVIC_CLRPEND0
.set isr_tx__INTC_MASK, 0x20
.set isr_tx__INTC_NUMBER, 5
.set isr_tx__INTC_PRIOR_NUM, 7
.set isr_tx__INTC_PRIOR_REG, CYREG_NVIC_PRI_5
.set isr_tx__INTC_SET_EN_REG, CYREG_NVIC_SETENA0
.set isr_tx__INTC_SET_PD_REG, CYREG_NVIC_SETPEND0

/* EXPST */
.set EXPST__0__MASK, 0x40
.set EXPST__0__PC, CYREG_PRT3_PC6
.set EXPST__0__PORT, 3
.set EXPST__0__SHIFT, 6
.set EXPST__AG, CYREG_PRT3_AG
.set EXPST__AMUX, CYREG_PRT3_AMUX
.set EXPST__BIE, CYREG_PRT3_BIE
.set EXPST__BIT_MASK, CYREG_PRT3_BIT_MASK
.set EXPST__BYP, CYREG_PRT3_BYP
.set EXPST__CTL, CYREG_PRT3_CTL
.set EXPST__DM0, CYREG_PRT3_DM0
.set EXPST__DM1, CYREG_PRT3_DM1
.set EXPST__DM2, CYREG_PRT3_DM2
.set EXPST__DR, CYREG_PRT3_DR
.set EXPST__INP_DIS, CYREG_PRT3_INP_DIS
.set EXPST__LCD_COM_SEG, CYREG_PRT3_LCD_COM_SEG
.set EXPST__LCD_EN, CYREG_PRT3_LCD_EN
.set EXPST__MASK, 0x40
.set EXPST__PORT, 3
.set EXPST__PRT, CYREG_PRT3_PRT
.set EXPST__PRTDSI__CAPS_SEL, CYREG_PRT3_CAPS_SEL
.set EXPST__PRTDSI__DBL_SYNC_IN, CYREG_PRT3_DBL_SYNC_IN
.set EXPST__PRTDSI__OE_SEL0, CYREG_PRT3_OE_SEL0
.set EXPST__PRTDSI__OE_SEL1, CYREG_PRT3_OE_SEL1
.set EXPST__PRTDSI__OUT_SEL0, CYREG_PRT3_OUT_SEL0
.set EXPST__PRTDSI__OUT_SEL1, CYREG_PRT3_OUT_SEL1
.set EXPST__PRTDSI__SYNC_OUT, CYREG_PRT3_SYNC_OUT
.set EXPST__PS, CYREG_PRT3_PS
.set EXPST__SHIFT, 6
.set EXPST__SLW, CYREG_PRT3_SLW

/* RST_B */
.set RST_B__0__MASK, 0x10
.set RST_B__0__PC, CYREG_PRT3_PC4
.set RST_B__0__PORT, 3
.set RST_B__0__SHIFT, 4
.set RST_B__AG, CYREG_PRT3_AG
.set RST_B__AMUX, CYREG_PRT3_AMUX
.set RST_B__BIE, CYREG_PRT3_BIE
.set RST_B__BIT_MASK, CYREG_PRT3_BIT_MASK
.set RST_B__BYP, CYREG_PRT3_BYP
.set RST_B__CTL, CYREG_PRT3_CTL
.set RST_B__DM0, CYREG_PRT3_DM0
.set RST_B__DM1, CYREG_PRT3_DM1
.set RST_B__DM2, CYREG_PRT3_DM2
.set RST_B__DR, CYREG_PRT3_DR
.set RST_B__INP_DIS, CYREG_PRT3_INP_DIS
.set RST_B__LCD_COM_SEG, CYREG_PRT3_LCD_COM_SEG
.set RST_B__LCD_EN, CYREG_PRT3_LCD_EN
.set RST_B__MASK, 0x10
.set RST_B__PORT, 3
.set RST_B__PRT, CYREG_PRT3_PRT
.set RST_B__PRTDSI__CAPS_SEL, CYREG_PRT3_CAPS_SEL
.set RST_B__PRTDSI__DBL_SYNC_IN, CYREG_PRT3_DBL_SYNC_IN
.set RST_B__PRTDSI__OE_SEL0, CYREG_PRT3_OE_SEL0
.set RST_B__PRTDSI__OE_SEL1, CYREG_PRT3_OE_SEL1
.set RST_B__PRTDSI__OUT_SEL0, CYREG_PRT3_OUT_SEL0
.set RST_B__PRTDSI__OUT_SEL1, CYREG_PRT3_OUT_SEL1
.set RST_B__PRTDSI__SYNC_OUT, CYREG_PRT3_SYNC_OUT
.set RST_B__PS, CYREG_PRT3_PS
.set RST_B__SHIFT, 4
.set RST_B__SLW, CYREG_PRT3_SLW

/* FREX */
.set FREX__0__MASK, 0x20
.set FREX__0__PC, CYREG_PRT3_PC5
.set FREX__0__PORT, 3
.set FREX__0__SHIFT, 5
.set FREX__AG, CYREG_PRT3_AG
.set FREX__AMUX, CYREG_PRT3_AMUX
.set FREX__BIE, CYREG_PRT3_BIE
.set FREX__BIT_MASK, CYREG_PRT3_BIT_MASK
.set FREX__BYP, CYREG_PRT3_BYP
.set FREX__CTL, CYREG_PRT3_CTL
.set FREX__DM0, CYREG_PRT3_DM0
.set FREX__DM1, CYREG_PRT3_DM1
.set FREX__DM2, CYREG_PRT3_DM2
.set FREX__DR, CYREG_PRT3_DR
.set FREX__INP_DIS, CYREG_PRT3_INP_DIS
.set FREX__LCD_COM_SEG, CYREG_PRT3_LCD_COM_SEG
.set FREX__LCD_EN, CYREG_PRT3_LCD_EN
.set FREX__MASK, 0x20
.set FREX__PORT, 3
.set FREX__PRT, CYREG_PRT3_PRT
.set FREX__PRTDSI__CAPS_SEL, CYREG_PRT3_CAPS_SEL
.set FREX__PRTDSI__DBL_SYNC_IN, CYREG_PRT3_DBL_SYNC_IN
.set FREX__PRTDSI__OE_SEL0, CYREG_PRT3_OE_SEL0
.set FREX__PRTDSI__OE_SEL1, CYREG_PRT3_OE_SEL1
.set FREX__PRTDSI__OUT_SEL0, CYREG_PRT3_OUT_SEL0
.set FREX__PRTDSI__OUT_SEL1, CYREG_PRT3_OUT_SEL1
.set FREX__PRTDSI__SYNC_OUT, CYREG_PRT3_SYNC_OUT
.set FREX__PS, CYREG_PRT3_PS
.set FREX__SHIFT, 5
.set FREX__SLW, CYREG_PRT3_SLW

/* HREF */
.set HREF__0__MASK, 0x01
.set HREF__0__PC, CYREG_PRT6_PC0
.set HREF__0__PORT, 6
.set HREF__0__SHIFT, 0
.set HREF__AG, CYREG_PRT6_AG
.set HREF__AMUX, CYREG_PRT6_AMUX
.set HREF__BIE, CYREG_PRT6_BIE
.set HREF__BIT_MASK, CYREG_PRT6_BIT_MASK
.set HREF__BYP, CYREG_PRT6_BYP
.set HREF__CTL, CYREG_PRT6_CTL
.set HREF__DM0, CYREG_PRT6_DM0
.set HREF__DM1, CYREG_PRT6_DM1
.set HREF__DM2, CYREG_PRT6_DM2
.set HREF__DR, CYREG_PRT6_DR
.set HREF__INP_DIS, CYREG_PRT6_INP_DIS
.set HREF__LCD_COM_SEG, CYREG_PRT6_LCD_COM_SEG
.set HREF__LCD_EN, CYREG_PRT6_LCD_EN
.set HREF__MASK, 0x01
.set HREF__PORT, 6
.set HREF__PRT, CYREG_PRT6_PRT
.set HREF__PRTDSI__CAPS_SEL, CYREG_PRT6_CAPS_SEL
.set HREF__PRTDSI__DBL_SYNC_IN, CYREG_PRT6_DBL_SYNC_IN
.set HREF__PRTDSI__OE_SEL0, CYREG_PRT6_OE_SEL0
.set HREF__PRTDSI__OE_SEL1, CYREG_PRT6_OE_SEL1
.set HREF__PRTDSI__OUT_SEL0, CYREG_PRT6_OUT_SEL0
.set HREF__PRTDSI__OUT_SEL1, CYREG_PRT6_OUT_SEL1
.set HREF__PRTDSI__SYNC_OUT, CYREG_PRT6_SYNC_OUT
.set HREF__PS, CYREG_PRT6_PS
.set HREF__SHIFT, 0
.set HREF__SLW, CYREG_PRT6_SLW

/* PCLK */
.set PCLK__0__MASK, 0x40
.set PCLK__0__PC, CYREG_PRT12_PC6
.set PCLK__0__PORT, 12
.set PCLK__0__SHIFT, 6
.set PCLK__AG, CYREG_PRT12_AG
.set PCLK__BIE, CYREG_PRT12_BIE
.set PCLK__BIT_MASK, CYREG_PRT12_BIT_MASK
.set PCLK__BYP, CYREG_PRT12_BYP
.set PCLK__DM0, CYREG_PRT12_DM0
.set PCLK__DM1, CYREG_PRT12_DM1
.set PCLK__DM2, CYREG_PRT12_DM2
.set PCLK__DR, CYREG_PRT12_DR
.set PCLK__INP_DIS, CYREG_PRT12_INP_DIS
.set PCLK__MASK, 0x40
.set PCLK__PORT, 12
.set PCLK__PRT, CYREG_PRT12_PRT
.set PCLK__PRTDSI__DBL_SYNC_IN, CYREG_PRT12_DBL_SYNC_IN
.set PCLK__PRTDSI__OE_SEL0, CYREG_PRT12_OE_SEL0
.set PCLK__PRTDSI__OE_SEL1, CYREG_PRT12_OE_SEL1
.set PCLK__PRTDSI__OUT_SEL0, CYREG_PRT12_OUT_SEL0
.set PCLK__PRTDSI__OUT_SEL1, CYREG_PRT12_OUT_SEL1
.set PCLK__PRTDSI__SYNC_OUT, CYREG_PRT12_SYNC_OUT
.set PCLK__PS, CYREG_PRT12_PS
.set PCLK__SHIFT, 6
.set PCLK__SIO_CFG, CYREG_PRT12_SIO_CFG
.set PCLK__SIO_DIFF, CYREG_PRT12_SIO_DIFF
.set PCLK__SIO_HYST_EN, CYREG_PRT12_SIO_HYST_EN
.set PCLK__SIO_REG_HIFREQ, CYREG_PRT12_SIO_REG_HIFREQ
.set PCLK__SLW, CYREG_PRT12_SLW

/* PWND */
.set PWND__0__MASK, 0x08
.set PWND__0__PC, CYREG_PRT3_PC3
.set PWND__0__PORT, 3
.set PWND__0__SHIFT, 3
.set PWND__AG, CYREG_PRT3_AG
.set PWND__AMUX, CYREG_PRT3_AMUX
.set PWND__BIE, CYREG_PRT3_BIE
.set PWND__BIT_MASK, CYREG_PRT3_BIT_MASK
.set PWND__BYP, CYREG_PRT3_BYP
.set PWND__CTL, CYREG_PRT3_CTL
.set PWND__DM0, CYREG_PRT3_DM0
.set PWND__DM1, CYREG_PRT3_DM1
.set PWND__DM2, CYREG_PRT3_DM2
.set PWND__DR, CYREG_PRT3_DR
.set PWND__INP_DIS, CYREG_PRT3_INP_DIS
.set PWND__LCD_COM_SEG, CYREG_PRT3_LCD_COM_SEG
.set PWND__LCD_EN, CYREG_PRT3_LCD_EN
.set PWND__MASK, 0x08
.set PWND__PORT, 3
.set PWND__PRT, CYREG_PRT3_PRT
.set PWND__PRTDSI__CAPS_SEL, CYREG_PRT3_CAPS_SEL
.set PWND__PRTDSI__DBL_SYNC_IN, CYREG_PRT3_DBL_SYNC_IN
.set PWND__PRTDSI__OE_SEL0, CYREG_PRT3_OE_SEL0
.set PWND__PRTDSI__OE_SEL1, CYREG_PRT3_OE_SEL1
.set PWND__PRTDSI__OUT_SEL0, CYREG_PRT3_OUT_SEL0
.set PWND__PRTDSI__OUT_SEL1, CYREG_PRT3_OUT_SEL1
.set PWND__PRTDSI__SYNC_OUT, CYREG_PRT3_SYNC_OUT
.set PWND__PS, CYREG_PRT3_PS
.set PWND__SHIFT, 3
.set PWND__SLW, CYREG_PRT3_SLW

/* VREF */
.set VREF__0__MASK, 0x80
.set VREF__0__PC, CYREG_PRT12_PC7
.set VREF__0__PORT, 12
.set VREF__0__SHIFT, 7
.set VREF__AG, CYREG_PRT12_AG
.set VREF__BIE, CYREG_PRT12_BIE
.set VREF__BIT_MASK, CYREG_PRT12_BIT_MASK
.set VREF__BYP, CYREG_PRT12_BYP
.set VREF__DM0, CYREG_PRT12_DM0
.set VREF__DM1, CYREG_PRT12_DM1
.set VREF__DM2, CYREG_PRT12_DM2
.set VREF__DR, CYREG_PRT12_DR
.set VREF__INP_DIS, CYREG_PRT12_INP_DIS
.set VREF__MASK, 0x80
.set VREF__PORT, 12
.set VREF__PRT, CYREG_PRT12_PRT
.set VREF__PRTDSI__DBL_SYNC_IN, CYREG_PRT12_DBL_SYNC_IN
.set VREF__PRTDSI__OE_SEL0, CYREG_PRT12_OE_SEL0
.set VREF__PRTDSI__OE_SEL1, CYREG_PRT12_OE_SEL1
.set VREF__PRTDSI__OUT_SEL0, CYREG_PRT12_OUT_SEL0
.set VREF__PRTDSI__OUT_SEL1, CYREG_PRT12_OUT_SEL1
.set VREF__PRTDSI__SYNC_OUT, CYREG_PRT12_SYNC_OUT
.set VREF__PS, CYREG_PRT12_PS
.set VREF__SHIFT, 7
.set VREF__SIO_CFG, CYREG_PRT12_SIO_CFG
.set VREF__SIO_DIFF, CYREG_PRT12_SIO_DIFF
.set VREF__SIO_HYST_EN, CYREG_PRT12_SIO_HYST_EN
.set VREF__SIO_REG_HIFREQ, CYREG_PRT12_SIO_REG_HIFREQ
.set VREF__SLW, CYREG_PRT12_SLW

/* XCLK */
.set XCLK__0__MASK, 0x04
.set XCLK__0__PC, CYREG_PRT3_PC2
.set XCLK__0__PORT, 3
.set XCLK__0__SHIFT, 2
.set XCLK__AG, CYREG_PRT3_AG
.set XCLK__AMUX, CYREG_PRT3_AMUX
.set XCLK__BIE, CYREG_PRT3_BIE
.set XCLK__BIT_MASK, CYREG_PRT3_BIT_MASK
.set XCLK__BYP, CYREG_PRT3_BYP
.set XCLK__CTL, CYREG_PRT3_CTL
.set XCLK__DM0, CYREG_PRT3_DM0
.set XCLK__DM1, CYREG_PRT3_DM1
.set XCLK__DM2, CYREG_PRT3_DM2
.set XCLK__DR, CYREG_PRT3_DR
.set XCLK__INP_DIS, CYREG_PRT3_INP_DIS
.set XCLK__LCD_COM_SEG, CYREG_PRT3_LCD_COM_SEG
.set XCLK__LCD_EN, CYREG_PRT3_LCD_EN
.set XCLK__MASK, 0x04
.set XCLK__PORT, 3
.set XCLK__PRT, CYREG_PRT3_PRT
.set XCLK__PRTDSI__CAPS_SEL, CYREG_PRT3_CAPS_SEL
.set XCLK__PRTDSI__DBL_SYNC_IN, CYREG_PRT3_DBL_SYNC_IN
.set XCLK__PRTDSI__OE_SEL0, CYREG_PRT3_OE_SEL0
.set XCLK__PRTDSI__OE_SEL1, CYREG_PRT3_OE_SEL1
.set XCLK__PRTDSI__OUT_SEL0, CYREG_PRT3_OUT_SEL0
.set XCLK__PRTDSI__OUT_SEL1, CYREG_PRT3_OUT_SEL1
.set XCLK__PRTDSI__SYNC_OUT, CYREG_PRT3_SYNC_OUT
.set XCLK__PS, CYREG_PRT3_PS
.set XCLK__SHIFT, 2
.set XCLK__SLW, CYREG_PRT3_SLW

/* LED */
.set LED__0__MASK, 0x04
.set LED__0__PC, CYREG_PRT6_PC2
.set LED__0__PORT, 6
.set LED__0__SHIFT, 2
.set LED__AG, CYREG_PRT6_AG
.set LED__AMUX, CYREG_PRT6_AMUX
.set LED__BIE, CYREG_PRT6_BIE
.set LED__BIT_MASK, CYREG_PRT6_BIT_MASK
.set LED__BYP, CYREG_PRT6_BYP
.set LED__CTL, CYREG_PRT6_CTL
.set LED__DM0, CYREG_PRT6_DM0
.set LED__DM1, CYREG_PRT6_DM1
.set LED__DM2, CYREG_PRT6_DM2
.set LED__DR, CYREG_PRT6_DR
.set LED__INP_DIS, CYREG_PRT6_INP_DIS
.set LED__LCD_COM_SEG, CYREG_PRT6_LCD_COM_SEG
.set LED__LCD_EN, CYREG_PRT6_LCD_EN
.set LED__MASK, 0x04
.set LED__PORT, 6
.set LED__PRT, CYREG_PRT6_PRT
.set LED__PRTDSI__CAPS_SEL, CYREG_PRT6_CAPS_SEL
.set LED__PRTDSI__DBL_SYNC_IN, CYREG_PRT6_DBL_SYNC_IN
.set LED__PRTDSI__OE_SEL0, CYREG_PRT6_OE_SEL0
.set LED__PRTDSI__OE_SEL1, CYREG_PRT6_OE_SEL1
.set LED__PRTDSI__OUT_SEL0, CYREG_PRT6_OUT_SEL0
.set LED__PRTDSI__OUT_SEL1, CYREG_PRT6_OUT_SEL1
.set LED__PRTDSI__SYNC_OUT, CYREG_PRT6_SYNC_OUT
.set LED__PS, CYREG_PRT6_PS
.set LED__SHIFT, 2
.set LED__SLW, CYREG_PRT6_SLW

/* RX */
.set RX__0__MASK, 0x02
.set RX__0__PC, CYREG_PRT3_PC1
.set RX__0__PORT, 3
.set RX__0__SHIFT, 1
.set RX__AG, CYREG_PRT3_AG
.set RX__AMUX, CYREG_PRT3_AMUX
.set RX__BIE, CYREG_PRT3_BIE
.set RX__BIT_MASK, CYREG_PRT3_BIT_MASK
.set RX__BYP, CYREG_PRT3_BYP
.set RX__CTL, CYREG_PRT3_CTL
.set RX__DM0, CYREG_PRT3_DM0
.set RX__DM1, CYREG_PRT3_DM1
.set RX__DM2, CYREG_PRT3_DM2
.set RX__DR, CYREG_PRT3_DR
.set RX__INP_DIS, CYREG_PRT3_INP_DIS
.set RX__LCD_COM_SEG, CYREG_PRT3_LCD_COM_SEG
.set RX__LCD_EN, CYREG_PRT3_LCD_EN
.set RX__MASK, 0x02
.set RX__PORT, 3
.set RX__PRT, CYREG_PRT3_PRT
.set RX__PRTDSI__CAPS_SEL, CYREG_PRT3_CAPS_SEL
.set RX__PRTDSI__DBL_SYNC_IN, CYREG_PRT3_DBL_SYNC_IN
.set RX__PRTDSI__OE_SEL0, CYREG_PRT3_OE_SEL0
.set RX__PRTDSI__OE_SEL1, CYREG_PRT3_OE_SEL1
.set RX__PRTDSI__OUT_SEL0, CYREG_PRT3_OUT_SEL0
.set RX__PRTDSI__OUT_SEL1, CYREG_PRT3_OUT_SEL1
.set RX__PRTDSI__SYNC_OUT, CYREG_PRT3_SYNC_OUT
.set RX__PS, CYREG_PRT3_PS
.set RX__SHIFT, 1
.set RX__SLW, CYREG_PRT3_SLW

/* TX */
.set TX__0__MASK, 0x01
.set TX__0__PC, CYREG_PRT3_PC0
.set TX__0__PORT, 3
.set TX__0__SHIFT, 0
.set TX__AG, CYREG_PRT3_AG
.set TX__AMUX, CYREG_PRT3_AMUX
.set TX__BIE, CYREG_PRT3_BIE
.set TX__BIT_MASK, CYREG_PRT3_BIT_MASK
.set TX__BYP, CYREG_PRT3_BYP
.set TX__CTL, CYREG_PRT3_CTL
.set TX__DM0, CYREG_PRT3_DM0
.set TX__DM1, CYREG_PRT3_DM1
.set TX__DM2, CYREG_PRT3_DM2
.set TX__DR, CYREG_PRT3_DR
.set TX__INP_DIS, CYREG_PRT3_INP_DIS
.set TX__LCD_COM_SEG, CYREG_PRT3_LCD_COM_SEG
.set TX__LCD_EN, CYREG_PRT3_LCD_EN
.set TX__MASK, 0x01
.set TX__PORT, 3
.set TX__PRT, CYREG_PRT3_PRT
.set TX__PRTDSI__CAPS_SEL, CYREG_PRT3_CAPS_SEL
.set TX__PRTDSI__DBL_SYNC_IN, CYREG_PRT3_DBL_SYNC_IN
.set TX__PRTDSI__OE_SEL0, CYREG_PRT3_OE_SEL0
.set TX__PRTDSI__OE_SEL1, CYREG_PRT3_OE_SEL1
.set TX__PRTDSI__OUT_SEL0, CYREG_PRT3_OUT_SEL0
.set TX__PRTDSI__OUT_SEL1, CYREG_PRT3_OUT_SEL1
.set TX__PRTDSI__SYNC_OUT, CYREG_PRT3_SYNC_OUT
.set TX__PS, CYREG_PRT3_PS
.set TX__SHIFT, 0
.set TX__SLW, CYREG_PRT3_SLW

/* Miscellaneous */
/* -- WARNING: define names containing LEOPARD or PANTHER are deprecated and will be removed in a future release */
.set CYDEV_DEBUGGING_DPS_SWD_SWV, 6
.set CYDEV_CONFIG_UNUSED_IO_AllowButWarn, 0
.set CYDEV_CONFIGURATION_MODE_COMPRESSED, 0
.set CYDEV_CONFIG_FASTBOOT_ENABLED, 1
.set CYDEV_CHIP_REV_PSOC5LP_PRODUCTION, 0
.set CYDEV_CHIP_REVISION_5B_PRODUCTION, 0
.set CYDEV_CHIP_MEMBER_5B, 3
.set CYDEV_CHIP_FAMILY_PSOC5, 3
.set CYDEV_CHIP_DIE_PSOC5LP, 3
.set CYDEV_CHIP_DIE_EXPECT, CYDEV_CHIP_DIE_PSOC5LP
.set BCLK__BUS_CLK__HZ, 24000000
.set BCLK__BUS_CLK__KHZ, 24000
.set BCLK__BUS_CLK__MHZ, 24
.set CYDEV_CHIP_DIE_ACTUAL, CYDEV_CHIP_DIE_EXPECT
.set CYDEV_CHIP_DIE_LEOPARD, 1
.set CYDEV_CHIP_DIE_PANTHER, 2
.set CYDEV_CHIP_DIE_UNKNOWN, 0
.set CYDEV_CHIP_FAMILY_PSOC3, 1
.set CYDEV_CHIP_FAMILY_PSOC4, 2
.set CYDEV_CHIP_FAMILY_UNKNOWN, 0
.set CYDEV_CHIP_FAMILY_USED, CYDEV_CHIP_FAMILY_PSOC5
.set CYDEV_CHIP_JTAG_ID, 0x2E123069
.set CYDEV_CHIP_MEMBER_3A, 1
.set CYDEV_CHIP_MEMBER_5A, 2
.set CYDEV_CHIP_MEMBER_UNKNOWN, 0
.set CYDEV_CHIP_MEMBER_USED, CYDEV_CHIP_MEMBER_5B
.set CYDEV_CHIP_REVISION_3A_ES1, 0
.set CYDEV_CHIP_REVISION_3A_ES2, 1
.set CYDEV_CHIP_REVISION_3A_ES3, 3
.set CYDEV_CHIP_REVISION_3A_PRODUCTION, 3
.set CYDEV_CHIP_REVISION_5A_ES0, 0
.set CYDEV_CHIP_REVISION_5A_ES1, 1
.set CYDEV_CHIP_REVISION_5A_PRODUCTION, 1
.set CYDEV_CHIP_REVISION_5B_ES0, 0
.set CYDEV_CHIP_REVISION_USED, CYDEV_CHIP_REVISION_5B_PRODUCTION
.set CYDEV_CHIP_REV_EXPECT, CYDEV_CHIP_REV_PSOC5LP_PRODUCTION
.set CYDEV_CHIP_REV_LEOPARD_ES1, 0
.set CYDEV_CHIP_REV_LEOPARD_ES2, 1
.set CYDEV_CHIP_REV_LEOPARD_ES3, 3
.set CYDEV_CHIP_REV_LEOPARD_PRODUCTION, 3
.set CYDEV_CHIP_REV_PANTHER_ES0, 0
.set CYDEV_CHIP_REV_PANTHER_ES1, 1
.set CYDEV_CHIP_REV_PANTHER_PRODUCTION, 1
.set CYDEV_CHIP_REV_PSOC5LP_ES0, 0
.set CYDEV_CONFIGURATION_COMPRESSED, 1
.set CYDEV_CONFIGURATION_DMA, 0
.set CYDEV_CONFIGURATION_ECC, 1
.set CYDEV_CONFIGURATION_IMOENABLED, CYDEV_CONFIG_FASTBOOT_ENABLED
.set CYDEV_CONFIGURATION_MODE, CYDEV_CONFIGURATION_MODE_COMPRESSED
.set CYDEV_CONFIGURATION_MODE_DMA, 2
.set CYDEV_CONFIGURATION_MODE_UNCOMPRESSED, 1
.set CYDEV_CONFIG_UNUSED_IO, CYDEV_CONFIG_UNUSED_IO_AllowButWarn
.set CYDEV_CONFIG_UNUSED_IO_AllowWithInfo, 1
.set CYDEV_CONFIG_UNUSED_IO_Disallowed, 2
.set CYDEV_DEBUGGING_DPS, CYDEV_DEBUGGING_DPS_SWD_SWV
.set CYDEV_DEBUGGING_DPS_Disable, 3
.set CYDEV_DEBUGGING_DPS_JTAG_4, 1
.set CYDEV_DEBUGGING_DPS_JTAG_5, 0
.set CYDEV_DEBUGGING_DPS_SWD, 2
.set CYDEV_DEBUGGING_ENABLE, 1
.set CYDEV_DEBUGGING_REQXRES, 1
.set CYDEV_DEBUGGING_XRES, 0
.set CYDEV_DEBUG_ENABLE_MASK, 0x20
.set CYDEV_DEBUG_ENABLE_REGISTER, CYREG_MLOGIC_DEBUG
.set CYDEV_DMA_CHANNELS_AVAILABLE, 24
.set CYDEV_ECC_ENABLE, 0
.set CYDEV_HEAP_SIZE, 0x1000
.set CYDEV_INSTRUCT_CACHE_ENABLED, 1
.set CYDEV_INTR_RISING, 0x0000003F
.set CYDEV_PROJ_TYPE, 0
.set CYDEV_PROJ_TYPE_BOOTLOADER, 1
.set CYDEV_PROJ_TYPE_LOADABLE, 2
.set CYDEV_PROJ_TYPE_MULTIAPPBOOTLOADER, 3
.set CYDEV_PROJ_TYPE_STANDARD, 0
.set CYDEV_PROTECTION_ENABLE, 0
.set CYDEV_STACK_SIZE, 0x4000
.set CYDEV_USE_BUNDLED_CMSIS, 1
.set CYDEV_VARIABLE_VDDA, 0
.set CYDEV_VDDA_MV, 5000
.set CYDEV_VDDD_MV, 5000
.set CYDEV_VDDIO0_MV, 5000
.set CYDEV_VDDIO1_MV, 5000
.set CYDEV_VDDIO2_MV, 5000
.set CYDEV_VDDIO3_MV, 5000
.set CYDEV_VIO0, 5
.set CYDEV_VIO0_MV, 5000
.set CYDEV_VIO1, 5
.set CYDEV_VIO1_MV, 5000
.set CYDEV_VIO2, 5
.set CYDEV_VIO2_MV, 5000
.set CYDEV_VIO3, 5
.set CYDEV_VIO3_MV, 5000
.set DMA_CHANNELS_USED__MASK0, 0x00000000
.set CYDEV_BOOTLOADER_ENABLE, 0
.endif
